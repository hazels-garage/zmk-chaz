## config/boards/arm/chaz/Kconfig.board
```kconfig
# Copyright (c) 2023 The ZMK Contributors
# SPDX-License-Identifier: MIT

config BOARD_CHAZ
    bool "Chaz"
    depends on SOC_STM32F072XB
```

## config/boards/arm/chaz/Kconfig.defconfig
```kconfig
# Copyright (c) 2020 The ZMK Contributors
# SPDX-License-Identifier: MIT

if BOARD_CHAZ

config BOARD
    default "chaz"

config ZMK_KEYBOARD_NAME
    default "Chaz"

config ZMK_USB
    default y

config ZMK_KSCAN_MATRIX_POLLING
    default y

endif # BOARD_CHAZ
```

## config/boards/shields/chaz/Kconfig.shield
```kconfig
# Copyright (c) 2023 The ZMK Contributors
# SPDX-License-Identifier: MIT

config SHIELD_CHAZ
    def_bool $(shields_list_contains,chaz)
```
